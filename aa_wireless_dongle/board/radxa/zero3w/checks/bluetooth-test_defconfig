## aa_wireless_dongle/board/radxa/zero3w/checks/bluetooth-test_defconfig
```kconfig
# Private diagnostic userspace only; reuses the separately checked boot chain.
BR2_aarch64=y
BR2_cortex_a55=y
BR2_TOOLCHAIN_EXTERNAL=y
BR2_TOOLCHAIN_EXTERNAL_BOOTLIN=y
BR2_TOOLCHAIN_EXTERNAL_BOOTLIN_AARCH64_GLIBC_STABLE=y
BR2_DL_DIR="$(TOPDIR)/output/radxa-bluetooth-test-prep/dl"
BR2_DOWNLOAD_FORCE_CHECK_HASHES=y
BR2_INIT_NONE=y
BR2_TARGET_GENERIC_HOSTNAME="radxa-bt-test"
# BR2_TARGET_GENERIC_GETTY is not set
BR2_PACKAGE_BUSYBOX_CONFIG="$(TOPDIR)/output/radxa-radio-test-prep/busybox-1.37.0/.config"
BR2_PACKAGE_BLUEZ5_UTILS=y
BR2_PACKAGE_BLUEZ5_UTILS_TOOLS=y
BR2_PACKAGE_BLUEZ5_UTILS_DEPRECATED=y
BR2_PACKAGE_BLUEZ5_UTILS_MONITOR=y
# BR2_PACKAGE_BLUEZ5_UTILS_PLUGINS_NETWORK is not set
BR2_TARGET_ROOTFS_CPIO=y
BR2_TARGET_ROOTFS_CPIO_GZIP=y
# BR2_TARGET_ROOTFS_TAR is not set
```

## aa_wireless_dongle/board/radxa/zero3w/checks/bootchain_defconfig
```kconfig
# Build-only source compatibility check; not a bootable dongle image.
BR2_aarch64=y
BR2_cortex_a55=y
BR2_TOOLCHAIN_EXTERNAL=y
BR2_TOOLCHAIN_EXTERNAL_BOOTLIN=y
BR2_TOOLCHAIN_EXTERNAL_BOOTLIN_AARCH64_GLIBC_STABLE=y
BR2_DOWNLOAD_FORCE_CHECK_HASHES=y
BR2_PACKAGE_ROCKCHIP_RKBIN=y
BR2_PACKAGE_ROCKCHIP_RKBIN_TPL_FILENAME="bin/rk35/rk3566_ddr_1056MHz_v1.23.bin"
BR2_PACKAGE_ROCKCHIP_RKBIN_BL31_FILENAME="bin/rk35/rk3568_bl31_v1.44.elf"
BR2_TARGET_UBOOT=y
BR2_TARGET_UBOOT_BUILD_SYSTEM_KCONFIG=y
BR2_TARGET_UBOOT_CUSTOM_VERSION=y
BR2_TARGET_UBOOT_CUSTOM_VERSION_VALUE="2026.01"
BR2_TARGET_UBOOT_BOARD_DEFCONFIG="radxa-zero-3-rk3566"
BR2_TARGET_UBOOT_NEEDS_ROCKCHIP_RKBIN=y
BR2_TARGET_UBOOT_USE_BINMAN=y
BR2_TARGET_UBOOT_NEEDS_OPENSSL=y
BR2_TARGET_UBOOT_NEEDS_GNUTLS=y
BR2_TARGET_UBOOT_FORMAT_CUSTOM=y
BR2_TARGET_UBOOT_FORMAT_CUSTOM_NAME="u-boot-rockchip.bin"
```

## aa_wireless_dongle/configs/radxa-zero3w_defconfig
```kconfig
# Radxa ZERO 3W (V1.12M, AIC8800D80): kernel and boot components per ADR-0001.
# Produces images/sdcard.img for a fresh microSD card.
BR2_aarch64=y
BR2_cortex_a55=y

# Toolchain
BR2_TOOLCHAIN_EXTERNAL=y
BR2_TOOLCHAIN_EXTERNAL_BOOTLIN=y
BR2_TOOLCHAIN_EXTERNAL_BOOTLIN_AARCH64_GLIBC_STABLE=y

# Patches and source verification
BR2_GLOBAL_PATCH_DIR="$(BR2_EXTERNAL_AA_WIRELESS_DONGLE_PATH)/patches $(BR2_EXTERNAL_AA_WIRELESS_DONGLE_PATH)/board/radxa/zero3w/patches"
BR2_DOWNLOAD_FORCE_CHECK_HASHES=y

# Kernel config
BR2_LINUX_KERNEL=y
BR2_LINUX_KERNEL_CUSTOM_VERSION=y
BR2_LINUX_KERNEL_CUSTOM_VERSION_VALUE="6.12.114"
BR2_LINUX_KERNEL_USE_ARCH_DEFAULT_CONFIG=y
BR2_LINUX_KERNEL_CONFIG_FRAGMENT_FILES="$(BR2_EXTERNAL_AA_WIRELESS_DONGLE_PATH)/board/common/kernel.config $(BR2_EXTERNAL_AA_WIRELESS_DONGLE_PATH)/board/radxa/zero3w/linux.fragment"
BR2_LINUX_KERNEL_NEEDS_HOST_OPENSSL=y

# Build the DTB from the kernel sources
BR2_LINUX_KERNEL_DTS_SUPPORT=y
BR2_LINUX_KERNEL_INTREE_DTS_NAME="rockchip/rk3566-radxa-zero-3w-aic8800d80"

# Bootloader: U-Boot with rkbin DDR and BL31
BR2_PACKAGE_ROCKCHIP_RKBIN=y
BR2_PACKAGE_ROCKCHIP_RKBIN_TPL_FILENAME="bin/rk35/rk3566_ddr_1056MHz_v1.23.bin"
BR2_PACKAGE_ROCKCHIP_RKBIN_BL31_FILENAME="bin/rk35/rk3568_bl31_v1.44.elf"
BR2_TARGET_UBOOT=y
BR2_TARGET_UBOOT_BUILD_SYSTEM_KCONFIG=y
BR2_TARGET_UBOOT_CUSTOM_VERSION=y
BR2_TARGET_UBOOT_CUSTOM_VERSION_VALUE="2026.01"
BR2_TARGET_UBOOT_BOARD_DEFCONFIG="radxa-zero-3-rk3566"
BR2_TARGET_UBOOT_NEEDS_ROCKCHIP_RKBIN=y
BR2_TARGET_UBOOT_USE_BINMAN=y
BR2_TARGET_UBOOT_NEEDS_OPENSSL=y
BR2_TARGET_UBOOT_NEEDS_GNUTLS=y
BR2_TARGET_UBOOT_FORMAT_CUSTOM=y
BR2_TARGET_UBOOT_FORMAT_CUSTOM_NAME="u-boot-rockchip.bin"

# Rootfs overlay
BR2_ROOTFS_OVERLAY="$(BR2_EXTERNAL_AA_WIRELESS_DONGLE_PATH)/board/common/rootfs_overlay $(BR2_EXTERNAL_AA_WIRELESS_DONGLE_PATH)/board/radxa/zero3w/rootfs_overlay"

# Enable compressed kernel module support
BR2_PACKAGE_BUSYBOX_SHOW_OTHERS=y
BR2_PACKAGE_KMOD=y
BR2_PACKAGE_KMOD_TOOLS=y
BR2_PACKAGE_XZ=y
BR2_PACKAGE_HOST_KMOD_XZ=y

# Required tools to create the SD image
BR2_PACKAGE_HOST_DOSFSTOOLS=y
BR2_PACKAGE_HOST_GENIMAGE=y
BR2_PACKAGE_HOST_MTOOLS=y

# Packages to bundle
BR2_PACKAGE_NANO=y
BR2_PACKAGE_RNG_TOOLS=y
BR2_PACKAGE_HAVEGED=y
BR2_PACKAGE_BLUEZ_TOOLS=y
BR2_PACKAGE_BLUEZ5_UTILS=y
BR2_PACKAGE_BLUEZ5_UTILS_CLIENT=y
BR2_PACKAGE_BLUEZ5_UTILS_TOOLS=y
BR2_PACKAGE_DNSMASQ=y
BR2_PACKAGE_DROPBEAR=y
BR2_PACKAGE_HOSTAPD=y
BR2_PACKAGE_WIRELESS_REGDB=y
BR2_PACKAGE_IW=y
BR2_PACKAGE_WPA_SUPPLICANT=y
BR2_PACKAGE_UTIL_LINUX=y
BR2_PACKAGE_UTIL_LINUX_RFKILL=y
BR2_PACKAGE_UMTPRD=y
BR2_PACKAGE_AAWG=y
BR2_PACKAGE_AIC8800=y
BR2_PACKAGE_AIC8800_FIRMWARE=y

# Other options
BR2_TARGET_GENERIC_ROOT_PASSWD="password"
# BR2_TARGET_GENERIC_GETTY is not set

# Filesystem / image
BR2_TARGET_GENERIC_REMOUNT_ROOTFS_RW=n
BR2_TARGET_ROOTFS_EXT2=y
BR2_TARGET_ROOTFS_EXT2_4=y
BR2_TARGET_ROOTFS_EXT2_SIZE="256M"
# BR2_TARGET_ROOTFS_TAR is not set
BR2_ROOTFS_POST_BUILD_SCRIPT="$(BR2_EXTERNAL_AA_WIRELESS_DONGLE_PATH)/board/radxa/zero3w/post-build.sh"
BR2_ROOTFS_POST_IMAGE_SCRIPT="support/scripts/genimage.sh"
BR2_ROOTFS_POST_SCRIPT_ARGS="-c $(BR2_EXTERNAL_AA_WIRELESS_DONGLE_PATH)/board/radxa/zero3w/genimage.cfg"
```

## aa_wireless_dongle/package/Config.in
```kconfig
menu "Packages"
    source "$BR2_EXTERNAL_AA_WIRELESS_DONGLE_PATH/package/aawg/Config.in"
    source "$BR2_EXTERNAL_AA_WIRELESS_DONGLE_PATH/package/aic8800/Config.in"
    source "$BR2_EXTERNAL_AA_WIRELESS_DONGLE_PATH/package/aic8800-firmware/Config.in"
    source "$BR2_EXTERNAL_AA_WIRELESS_DONGLE_PATH/package/dbus-cxx-custom/Config.in"
endmenu
```

## aa_wireless_dongle/package/aic8800-firmware/Config.in
```kconfig
config BR2_PACKAGE_AIC8800_FIRMWARE
	bool "aic8800-firmware"
	help
	  AIC8800D80 U02 Bluetooth and SDIO Wi-Fi firmware from
	  linux-firmware, installed where the aic8800 driver loads it.
	  The driver's transmit-power configuration is installed by the
	  aic8800 package.

	  https://gitlab.com/kernel-firmware/linux-firmware
```

## aa_wireless_dongle/package/aic8800-startup/Config.in
```kconfig
config BR2_PACKAGE_AIC8800_STARTUP
	bool "aic8800-startup"
	depends on BR2_PACKAGE_AIC8800
	depends on BR2_PACKAGE_BLUEZ5_UTILS_TOOLS # btattach
	help
	  Boot-time startup of the AIC8800D80 radio on the Radxa ZERO 3W:
	  loads the Wi-Fi driver, checks firmware readiness, resets the
	  Bluetooth controller over its UART and attaches it to BlueZ.
	  Installs the aic-firmware-ready.sh and aic-hci-reset helpers
	  and the S38radio init script.

comment "aic8800-startup needs aic8800 and bluez5-utils tools"
	depends on !BR2_PACKAGE_AIC8800 || !BR2_PACKAGE_BLUEZ5_UTILS_TOOLS
```

## aa_wireless_dongle/package/aic8800/Config.in
```kconfig
config BR2_PACKAGE_AIC8800
	bool "aic8800"
	depends on BR2_LINUX_KERNEL
	help
	  AIC8800 SDIO Wi-Fi and Bluetooth BSP driver (aic8800_bsp and
	  aic8800_fdrv) from Radxa's packaging of the AIC SDK, for the
	  AIC8800D80 radio on the Radxa ZERO 3W. Firmware is not
	  installed by this package.

	  https://github.com/radxa-pkg/aic8800

comment "aic8800 needs a Linux kernel to be built"
	depends on !BR2_LINUX_KERNEL
```
